/*###ICF### Set of symbols used in SE and SB_SFU projects ****/

/* Slots Regions must be aligned on 2048 bytes (0x800) */

/* swap region 16 kbytes */
define exported symbol  __ICFEDIT_region_SWAP_start__  = 0x080EC800; /* page 473 */
define exported symbol  __ICFEDIT_region_SWAP_end__    = 0x080F07FF; /* page 480 */

/* slot 0 region 0x6C000 = 27 section of 16 kbytes (432kbytes) */
define exported symbol  __ICFEDIT_region_SLOT_0_start__= 0x08080800; /* page 257 */
define exported symbol  __ICFEDIT_region_SLOT_0_end__  = 0x080EC7FF; /* page 472 */

/* slot 1 region 0x6C000 = 27 section of 16 kbytes (432kbytes) */
define exported symbol  __ICFEDIT_region_SLOT_1_start__= 0x08014000; /* page 40  */
define exported symbol  __ICFEDIT_region_SLOT_1_end__  = 0x0807FFFF; /* page 255 */

/* firmware images regions definition */
define region SWAP_region   = mem:[from __ICFEDIT_region_SWAP_start__ to __ICFEDIT_region_SWAP_end__];
define region SLOT_0_region = mem:[from __ICFEDIT_region_SLOT_0_start__ to __ICFEDIT_region_SLOT_0_end__];
define region SLOT_1_region = mem:[from __ICFEDIT_region_SLOT_1_start__ to __ICFEDIT_region_SLOT_1_end__];
