/*###ICF### Set of symbols used in SE and SB_SFU projects ****/

/* Slots Regions must be aligned on sectors */

/* swap region 128 kbytes */
define exported symbol  __ICFEDIT_region_SWAP_start__ = 0x08020000;
define exported symbol  __ICFEDIT_region_SWAP_end__   = 0x0803FFFF;

/* slot 0 region 0xA0000 = 4 sections of 128 kbytes (512 kbytes) */
define exported symbol  __ICFEDIT_region_SLOT_0_start__= 0x08040000;
define exported symbol  __ICFEDIT_region_SLOT_0_end__  =  0x080BFFFF;

/* slot 1 region 0xA0000 = 4 sections of 128 kbytes (512 kbytes) */
define exported symbol  __ICFEDIT_region_SLOT_1_start__= 0x080E0000;
define exported symbol  __ICFEDIT_region_SLOT_1_end__  =  0x0815FFFF;

/* firmware images regions definition */
define region SWAP_region   = mem:[from __ICFEDIT_region_SWAP_start__ to __ICFEDIT_region_SWAP_end__];
define region SLOT_0_region = mem:[from __ICFEDIT_region_SLOT_0_start__ to __ICFEDIT_region_SLOT_0_end__];
define region SLOT_1_region = mem:[from __ICFEDIT_region_SLOT_1_start__ to __ICFEDIT_region_SLOT_1_end__];
