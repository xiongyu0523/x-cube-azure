/*###ICF### Set of symbols used in SE and SB_SFU projects ****/

/* Slots Regions must be aligned on 2048 bytes (0x800) */

/* swap region 8 kbytes */
define exported symbol  __ICFEDIT_region_SWAP_start__  = 0x080EE800; /* page 477 */
define exported symbol  __ICFEDIT_region_SWAP_end__    = 0x080F07FF; /* page 480 */

/* slot 0 region 0x6E000 = 55 section of 8 kbytes (440kbytes) */
define exported symbol  __ICFEDIT_region_SLOT_0_start__= 0x08080800; /* page 257 */
define exported symbol  __ICFEDIT_region_SLOT_0_end__  = 0x080EE7FF; /* page 476 */

/* slot 1 region 0x6E000 = 55 section of 8 kbytes (440kbytes) */
define exported symbol  __ICFEDIT_region_SLOT_1_start__= 0x08012000; /* page 36  */
define exported symbol  __ICFEDIT_region_SLOT_1_end__  = 0x0807ffff; /* page 255 */

/* firmware images regions definition */
define region SWAP_region   = mem:[from __ICFEDIT_region_SWAP_start__ to __ICFEDIT_region_SWAP_end__];
define region SLOT_0_region = mem:[from __ICFEDIT_region_SLOT_0_start__ to __ICFEDIT_region_SLOT_0_end__];
define region SLOT_1_region = mem:[from __ICFEDIT_region_SLOT_1_start__ to __ICFEDIT_region_SLOT_1_end__];
