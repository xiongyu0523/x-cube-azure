/*###ICF### Set of symbols used in SE and SB_SFU projects ****/

/* Slots Regions must be aligned on sector size */

/* swap region Sector 5 : 256 kbytes */
define exported symbol  __ICFEDIT_region_SWAP_start__ = 0x08040000;
define exported symbol  __ICFEDIT_region_SWAP_end__   = 0x0807FFFF;

/* slot 0 region : 3 sectors of 256 kbytes (768 kbytes) */
define exported symbol  __ICFEDIT_region_SLOT_0_start__= 0x08080000;
define exported symbol  __ICFEDIT_region_SLOT_0_end__  = 0x0813FFFF;

/* slot 1 region : 3 sectors of 256 kbytes (768 kbytes) */
define exported symbol  __ICFEDIT_region_SLOT_1_start__= 0x08140000;
define exported symbol  __ICFEDIT_region_SLOT_1_end__  = 0x081FFFFF;

/* firmware images regions definition */
define region SWAP_region   = mem:[from __ICFEDIT_region_SWAP_start__ to __ICFEDIT_region_SWAP_end__];
define region SLOT_0_region = mem:[from __ICFEDIT_region_SLOT_0_start__ to __ICFEDIT_region_SLOT_0_end__];
define region SLOT_1_region = mem:[from __ICFEDIT_region_SLOT_1_start__ to __ICFEDIT_region_SLOT_1_end__];
